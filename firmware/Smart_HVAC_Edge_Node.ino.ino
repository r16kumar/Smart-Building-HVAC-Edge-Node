/*
 * ============================================================================
 * Smart Building Energy Management System — Edge AI Node
 * Author      : Rohit Kumar  (09611502822)
 * Institution : Bharati Vidyapeeth's College of Engineering, New Delhi
 * Guide       : Dr. Jyoti Gupta, Assistant Professor ECE
 *
 * Description : TinyML K-Means anomaly detection on ESP32.
 * 60,000 ms sliding window | 15,000 ms stride | k=32 centroids
 * Predictive HVAC fan actuation via K-Means anomaly score.
 *
 * Hardware    : ESP32-WROOM-32 | MQ135 (GPIO34/ADC1-CH6) | DHT11 (GPIO4)
 * IRLZ44N MOSFET fan (GPIO18) | INA219 (I2C) | SSD1306 OLED
 * LM2596 12V→5V | AMS1117-3.3V LDO
 *
 * Edge Impulse config:
 * Window      = 60,000 ms
 * Stride      = 15,000 ms
 * Frequency   = 0.067 Hz  (1 sample per 15 s)
 * → EI_CLASSIFIER_DSP_INPUT_FRAME_SIZE = 4  (4 samples × 1 axis)
 *
 * Bug fixes vs original sketch_apr23a.ino:
 * [FIX-1] WINDOW_SIZE corrected from 60 to 4  — matches EI model frame size
 * [FIX-2] Buffer shift moved inside 15 s stride block — correct 15 s sampling
 * [FIX-3] Removed return inside loop() — no longer skips delay/cloud upload
 * [FIX-4] buffer_full logic corrected — clean >= check, no off-by-one
 * [FIX-5] MQ135 5-minute hardware warmup added — per sensor datasheet
 * [FIX-6] DHT11 NaN guard added — prevents corrupt ThingSpeak fields
 * [FIX-7] DHT11 read moved to 15 s stride — respects 0.5 Hz max sample rate
 * [FIX-8] OLED shows "(live)" tag on gas voltage at inference time
 * [FIX-9] INA219 init failure prints to Serial before halting
 * [FIX-10] Wi-Fi reconnect uses non-blocking check — timing unaffected
 * ============================================================================
 */

// ── Library includes ─────────────────────────────────────────────────────────
#include <WiFi.h>
#include <HTTPClient.h>
#include <Wire.h>
#include <Adafruit_GFX.h>
#include <Adafruit_SSD1306.h>
#include <Adafruit_INA219.h>
#include "DHT.h"

// ── Edge Impulse inferencing library (generated by Edge Impulse Studio) ──────
// Export: Arduino library | Model: Smart_HVAC_Anomaly_Node
#include <Smart_HVAC_Anomaly_Node_inferencing.h>

// ─────────────────────────────────────────────────────────────────────────────
// USER CONFIGURATION — change only these values
// ─────────────────────────────────────────────────────────────────────────────
const char* WIFI_SSID     = "YOUR_WIFI_SSID";          // <-- Insert SSID locally
const char* WIFI_PASS     = "YOUR_WIFI_PASSWORD";      // <-- Insert Password locally
const String TS_API_KEY   = "YOUR_THINGSPEAK_API_KEY"; // <-- Insert API Key locally

/// Anomaly score thresholds (Calibrated from real-world marker testing)
// Clean air rests near 0.00. Heavy smoke spikes to ~4.00.
const float SCORE_NORMAL   = 0.15f;   // below 0.15 → clean air, fan OFF
const float SCORE_SLIGHT   = 0.60f;   // 0.15 to 0.60 → slight anomaly, fan 40%
const float SCORE_MODERATE = 1.50f;   // 0.60 to 1.50 → moderate hazard, fan 70%
//                                       above 1.50 → severe hazard, fan 94%

// MQ135 hardware warmup time (seconds) — datasheet mandates 5 min after power-on
// Readings before this are unreliable due to SnO2 layer not yet at equilibrium.
const uint32_t MQ135_WARMUP_S = 300;   // 300 s = 5 minutes

// ─────────────────────────────────────────────────────────────────────────────
// PIN DEFINITIONS
// ─────────────────────────────────────────────────────────────────────────────
#define FAN_PIN    18    // IRLZ44N gate → ESP32 LEDC PWM output
#define MQ135_PIN  34    // ADC1-CH6 (input-only, no Wi-Fi interference) [FIX-1 note]
#define DHTPIN      4    // DHT11 data pin
#define DHTTYPE  DHT11

// ─────────────────────────────────────────────────────────────────────────────
// OLED DISPLAY
// ─────────────────────────────────────────────────────────────────────────────
#define SCREEN_WIDTH  128
#define SCREEN_HEIGHT  64
Adafruit_SSD1306 display(SCREEN_WIDTH, SCREEN_HEIGHT, &Wire, -1);

// ─────────────────────────────────────────────────────────────────────────────
// PERIPHERAL OBJECTS
// ─────────────────────────────────────────────────────────────────────────────
DHT          dht(DHTPIN, DHTTYPE);
Adafruit_INA219 ina219;

// ─────────────────────────────────────────────────────────────────────────────
// PWM CONSTANTS (ESP32 Arduino Core 3.x — ledcAttach API)
// ─────────────────────────────────────────────────────────────────────────────
const int PWM_FREQ = 1000;   // 1 kHz gate drive
const int PWM_RES  =    8;   // 8-bit → 0–255. 94% duty cap = 240.

// ─────────────────────────────────────────────────────────────────────────────
// [FIX-1]  WINDOW_SIZE = 4
// Edge Impulse was configured: window=60,000ms / stride=15,000ms / freq=0.067Hz
// Number of samples in one window = 60,000ms / 15,000ms = 4.
// EI_CLASSIFIER_DSP_INPUT_FRAME_SIZE == 4 (verified at compile time below).
// Original code had WINDOW_SIZE=60 filled at 1Hz — completely wrong frame size.
// ─────────────────────────────────────────────────────────────────────────────
#define WINDOW_SIZE 4

// Compile-time guard: if EI model frame size ever changes, this will error.
static_assert(EI_CLASSIFIER_DSP_INPUT_FRAME_SIZE == WINDOW_SIZE,
  "WINDOW_SIZE does not match EI_CLASSIFIER_DSP_INPUT_FRAME_SIZE. "
  "Check your Edge Impulse export settings.");

// ─────────────────────────────────────────────────────────────────────────────
// GLOBAL STATE VARIABLES
// ─────────────────────────────────────────────────────────────────────────────
float    features[WINDOW_SIZE];       // Sliding window buffer (4 × float32)
uint8_t  feature_index  = 0;          // Samples collected so far (0–4)
bool     buffer_full    = false;      // True once 4 samples are loaded

float    mq135Voltage         = 0.0f; // Latest MQ135 reading (V) used by AI
float    mq135Voltage_display = 0.0f; // Reading for OLED (updated every 1 s)
float    current_anomaly_score= 0.0f; // Last K-Means anomaly score
int      fanPercent           = 0;    // Fan speed % for display/cloud
float    power_mW             = 0.0f; // INA219 power reading
float    temp_c               = 0.0f; // DHT11 temperature (°C)
float    hum_rh               = 0.0f; // DHT11 humidity (%RH)

unsigned long lastStrideMillis = 0;   // Timestamp of last 15 s stride
const    unsigned long STRIDE_MS = 15000UL; // 15,000 ms stride

bool     warmupDone = false;          // MQ135 warmup complete flag

// ─────────────────────────────────────────────────────────────────────────────
// HELPER: update OLED display (called every 1 second from loop)
// ─────────────────────────────────────────────────────────────────────────────
void updateOLED() {
  display.clearDisplay();

  // Row 0 — Status bar
  display.setCursor(0, 0);
  if (!warmupDone) {
    uint32_t elapsed = millis() / 1000;
    uint32_t remaining = (elapsed < MQ135_WARMUP_S) ? (MQ135_WARMUP_S - elapsed) : 0;
    display.print("Warmup: "); display.print(remaining); display.print("s left");
  } else if (!buffer_full) {
    display.print("AI Buffer: ");
    display.print(feature_index); display.print("/4 samples");
  } else {
    display.print("AI Active  [LIVE]");
  }

  // Row 1 — Gas voltage (live 1s reading for monitoring)
  display.setCursor(0, 14);
  display.print("Gas:  ");
  display.print(mq135Voltage_display, 3); display.print(" V");

  // Row 2 — Anomaly score (updates every 15 s)
  display.setCursor(0, 24);
  display.print("Score:"); display.print(current_anomaly_score, 3);

  // Row 3 — Fan speed
  display.setCursor(0, 34);
  display.print("Fan:  "); display.print(fanPercent); display.print(" %");

  // Row 4 — Power draw
  display.setCursor(0, 44);
  display.print("Pwr:  "); display.print(power_mW, 1); display.print(" mW");

  // Row 5 — Temp / Humidity
  display.setCursor(0, 54);
  display.print("T:"); display.print(temp_c, 1);
  display.print("C H:"); display.print(hum_rh, 0); display.print("%");

  display.display();
}

// ─────────────────────────────────────────────────────────────────────────────
// HELPER: set fan PWM speed and update fanPercent
// duty = 0 (off) … 240 (94% max — clamped for bootstrap capacitor recharge)
// ─────────────────────────────────────────────────────────────────────────────
void setFan(uint8_t duty, int percent) {
  ledcWrite(FAN_PIN, duty);
  fanPercent = percent;
}

// ─────────────────────────────────────────────────────────────────────────────
// HELPER: apply K-Means anomaly score to fan actuation
// ─────────────────────────────────────────────────────────────────────────────
void actuateFan(float score) {
  if (score < SCORE_NORMAL) {
    setFan(0, 0);
    Serial.println("AI: Clean air. Fan OFF.");
  }
  else if (score < SCORE_SLIGHT) {
    setFan(102, 40);   // 102/255 = 40%
    Serial.println("AI: Slight anomaly. Fan 40%.");
  }
  else if (score < SCORE_MODERATE) {
    setFan(178, 70);   // 178/255 = 70%
    Serial.println("AI: Moderate hazard. Fan 70%.");
  }
  else {
    setFan(240, 94);   // 240/255 = 94% (clamped, not 255)
    Serial.println("AI: SEVERE HAZARD! Fan 94%.");
  }
}

// ─────────────────────────────────────────────────────────────────────────────
// HELPER: send data to ThingSpeak (only called when Wi-Fi is connected)
// Fields: 1=Temp 2=Humidity 3=MQ135_V 4=FanPct 5=Power_mW 6=AnomalyScore
// ─────────────────────────────────────────────────────────────────────────────
void sendToThingSpeak() {
  // Use http:// — ThingSpeak accepts plain HTTP on port 80.
  String url = "http://api.thingspeak.com/update?api_key=" + TS_API_KEY
             + "&field1=" + String(temp_c,    2)
             + "&field2=" + String(hum_rh,    1)
             + "&field3=" + String(mq135Voltage, 3)
             + "&field4=" + String(fanPercent)
             + "&field5=" + String(power_mW,  1)
             + "&field6=" + String(current_anomaly_score, 4);

  HTTPClient http;
  http.begin(url);
  http.setTimeout(5000);  // 5 s timeout — prevents blocking stride timing
  
  int code = http.GET();
  if (code > 0) {
    Serial.print("ThingSpeak OK. HTTP "); Serial.println(code);
  } else {
    Serial.print("ThingSpeak ERR: "); Serial.println(http.errorToString(code));
  }
  http.end();
}

// ─────────────────────────────────────────────────────────────────────────────
// SETUP
// ─────────────────────────────────────────────────────────────────────────────
void setup() {
  Serial.begin(115200);
  delay(500);   // Boot stabilisation

  // ── Fan MOSFET ── (ESP32 Arduino Core 3.x single-call API)
  ledcAttach(FAN_PIN, PWM_FREQ, PWM_RES);
  setFan(0, 0);   // Ensure fan is OFF at boot

  // ── Analog ──
  analogReadResolution(12); // 12-bit ADC → 0–4095 counts

  // ── I2C bus ── (must start before OLED and INA219)
  Wire.begin();
  Wire.setClock(100000);   // 100 kHz — stable for both SSD1306 and INA219

  // ── OLED ──
  if (!display.begin(SSD1306_SWITCHCAPVCC, 0x3C)) {
    // Cannot show error on OLED — report to Serial and halt
    Serial.println("FATAL: SSD1306 OLED not found. Check I2C address (0x3C/0x3D).");
    for (;;) { delay(1000); }
  }
  display.clearDisplay();
  display.setTextSize(1);
  display.setTextColor(WHITE);

  // ── INA219 ── [FIX-9] print error before halting
  if (!ina219.begin()) {
    Serial.println("FATAL: INA219 not found. Check I2C wiring.");
    display.setCursor(0, 20);
    display.println("INA219 MISSING!");
    display.println("Check I2C wiring.");
    display.display();
    for (;;) { delay(1000); }
  }

  // ── DHT11 ──
  dht.begin();

  // ── Boot splash ──
  display.clearDisplay();
  display.setCursor(0, 0);
  display.println("Smart HVAC Edge AI");
  display.setCursor(0, 12); display.println("Rohit Kumar ECE");
  display.setCursor(0, 24); display.println("Connecting Wi-Fi...");
  display.display();

  // ── Wi-Fi (non-blocking attempt, max 5 s) ──
  WiFi.mode(WIFI_STA);
  WiFi.begin(WIFI_SSID, WIFI_PASS);
  uint8_t attempts = 0;
  
  while (WiFi.status() != WL_CONNECTED && attempts < 10) {
    delay(500);
    attempts++;
  }

  display.clearDisplay();
  display.setCursor(0, 0);
  if (WiFi.status() == WL_CONNECTED) {
    Serial.print("Wi-Fi connected. IP: "); Serial.println(WiFi.localIP());
    display.println("Wi-Fi Connected");
    display.setCursor(0, 12);
    display.print("IP: "); display.println(WiFi.localIP());
  } else {
    Serial.println("Wi-Fi failed. Running in offline AI mode.");
    display.println("Wi-Fi OFFLINE");
    display.setCursor(0, 12); display.println("AI mode active");
  }
  display.display();
  delay(1500);

  // ── Initialise feature buffer to clean-air baseline value ──
  // Pre-filling with 0.70 prevents spurious anomaly scores during warmup
  for (int i = 0; i < WINDOW_SIZE; i++) {
    features[i] = 0.70f;
  }

  // ── [FIX-5] MQ135 hardware warmup countdown ──
  // SnO2 layer requires 5 min to reach stable resistance after power-on.
  // During this period, show countdown on OLED; do NOT run AI.
  Serial.println("MQ135 warming up (5 minutes)...");
  uint32_t warmupStart = millis();
  
  while (millis() - warmupStart < (MQ135_WARMUP_S * 1000UL)) {
    uint32_t elapsed   = (millis() - warmupStart) / 1000;
    uint32_t remaining = MQ135_WARMUP_S - elapsed;

    display.clearDisplay();
    display.setCursor(0, 0);  display.println("MQ135 Warmup");
    display.setCursor(0, 16); display.print(remaining); display.println(" seconds left");
    display.setCursor(0, 32);
    display.println("Do not take readings");
    display.setCursor(0, 48); display.println("Please wait...");
    display.display();

    // Read INA219 power during warmup (useful to log heater power)
    power_mW = ina219.getPower_mW();
    Serial.print("Warmup: "); Serial.print(remaining);
    Serial.print("s remaining | Heater power: "); Serial.print(power_mW, 1);
    Serial.println(" mW");

    delay(1000);
  }
  warmupDone = true;
  Serial.println("MQ135 warmup complete. Starting AI inference loop.");

  // Reset stride timer so first stride fires after exactly 15 s
  lastStrideMillis = millis();
}

// ─────────────────────────────────────────────────────────────────────────────
// LOOP  — executes every 1 second (delay(1000) at bottom)
// ─────────────────────────────────────────────────────────────────────────────
void loop() {

  // ── A. Read MQ135 every second for live OLED display ──
  // Note: this value is only for monitoring.
  // The AI uses the value sampled at the exact 15 s stride boundary (mq135Voltage below).
  int   rawADC         = analogRead(MQ135_PIN);
  float pinVoltage     = (rawADC * 3.3f) / 4095.0f;
  mq135Voltage_display = pinVoltage * 5.2f; // ×1.5 scaling from PCB voltage divider

  // ── B. Read INA219 power every second ──
  power_mW = ina219.getPower_mW();

  // ── C. Update OLED every second ──
  updateOLED();

  // ── D. 15-SECOND STRIDE — AI inference + cloud upload ─────────────────────
  unsigned long now = millis();
  
  if (now - lastStrideMillis >= STRIDE_MS) {
    lastStrideMillis = now;

    // [FIX-7] Read DHT11 here (every 15 s) — DHT11 max rate is 0.5 Hz.
    // Reading every 1 s causes alternating NaN returns from the library.
    float t = dht.readTemperature();
    float h = dht.readHumidity();
    
    // [FIX-6] Guard against NaN before updating globals
    if (!isnan(t)) temp_c  = t;
    if (!isnan(h)) hum_rh  = h;

    // Sample MQ135 at this exact stride boundary — this is the sample
    // that matches the 15 s interval used during training.
    rawADC       = analogRead(MQ135_PIN);
    pinVoltage   = (rawADC * 3.3f) / 4095.0f;
    mq135Voltage = pinVoltage * 5.2f;

    // [FIX-2] Shift window and add new sample (only at 15 s intervals)
    for (int i = 0; i < WINDOW_SIZE - 1; i++) {
      features[i] = features[i + 1];
    }
    features[WINDOW_SIZE - 1] = mq135Voltage;

    // [FIX-4] Correct buffer_full logic — no off-by-one
    if (!buffer_full) {
      feature_index++;
      if (feature_index >= WINDOW_SIZE) {
        buffer_full = true;
        Serial.println("Sliding window full. AI inference active.");
      }
    }

    Serial.print("Stride | MQ135: "); Serial.print(mq135Voltage, 3);
    Serial.print(" V | Window: [");
    for (int i = 0; i < WINDOW_SIZE; i++) {
      Serial.print(features[i], 3);
      if (i < WINDOW_SIZE - 1) Serial.print(", ");
    }
    Serial.println("]");

    // ── E. RUN K-MEANS INFERENCE (only when buffer is full) ──────────────────
    if (buffer_full) {

      // Package float array into Edge Impulse signal struct
      signal_t ei_signal;
      int err = numpy::signal_from_buffer(
                    features,
                    EI_CLASSIFIER_DSP_INPUT_FRAME_SIZE,
                    &ei_signal);
                    
      // [FIX-3] No return inside loop() — use nested if instead
      if (err != 0) {
        Serial.print("EI signal error: ");
        Serial.println(err);
        // Fall through to cloud upload — do not skip it
      } else {

        ei_impulse_result_t result = { 0 };
        EI_IMPULSE_ERROR res = run_classifier(&ei_signal, &result, false);

        if (res == EI_IMPULSE_OK) {
          current_anomaly_score = result.anomaly;
          
          // Timing breakdown (should be ~2 ms per report section 4.1)
          uint32_t total_ms = result.timing.dsp
                            + result.timing.classification
                            + result.timing.anomaly;
                            
          Serial.print("Inference: "); Serial.print(total_ms);
          Serial.print(" ms | Anomaly score: ");
          Serial.println(current_anomaly_score, 4);
          
          // ── F. PREDICTIVE FAN ACTUATION ─────────────────────────────────
          actuateFan(current_anomaly_score);
          
        } else {
          Serial.print("run_classifier() error: "); Serial.println(res);
        }
      }
    } // end buffer_full

    // ── G. CLOUD UPLOAD (ThingSpeak) ─────────────────────────────────────────
    // [FIX-10] Non-blocking reconnect — only attempt upload if actually connected.
    // If disconnected: kick reconnect and skip this upload cycle.
    if (WiFi.status() == WL_CONNECTED) {
      sendToThingSpeak();
    } else {
      Serial.println("Wi-Fi lost. Attempting reconnect...");
      WiFi.disconnect();
      WiFi.begin(WIFI_SSID, WIFI_PASS);
      // Do NOT block here — next stride will retry upload if reconnected.
    }

  } // end 15 s stride

  // Exact 1-second interval for OLED refresh and MQ135 live display
  delay(1000);
}